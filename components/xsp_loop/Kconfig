## components/xsp_loop/Kconfig
```kconfig
# Copyright 2019 Tricot Inc.
# Use of this source code is governed by the license in the LICENSE file.

menu "XSP event loop"

config XSP_LOOP_DEFAULT_POLL_TIMEOUT_MS
    int "Default poll timeout in milliseconds (default 0)"
    default 0
    range 0 1000000000
    help
        The default poll timeout for a XSP WS client loop.

endmenu
```

## components/xsp_ws_client/Kconfig
```kconfig
# Copyright 2019 Tricot Inc.
# Use of this source code is governed by the license in the LICENSE file.

menu "XSP WS (WebSocket) client"

config XSP_WS_CLIENT_WRITE_FRAME_BUFFER_SIZE
    int "Write frame buffer size (minimum 4; multiple of 4; default 128)"
    default 128
    range 4 65536
	help
		The (stack) buffer size for xsp_ws_client_write_frame().

config XSP_WS_CLIENT_CLOSE_DELAY_MS
    int "Close delay time in milliseconds (default 100)"
    default 100
    range 0 1000
	help
		The delay before closing the transport, to allow written data to be sent.

config XSP_WS_CLIENT_LOOP_DEFAULT_MAX_FRAME_READ_SIZE
    int "Default maximum frame read size for loop (minimum 125; default 1024)"
    default 1024
    range 125 1000000000
    help
        The default maximum frame read size for a XSP WS client loop. This is the maximum frame
        (payload) size that can be accepted.

config XSP_WS_CLIENT_LOOP_DEFAULT_MAX_DATA_FRAME_WRITE_SIZE
    int "Default maximum data frame write size for loop (minimum 1; default 1024)"
    default 1024
    range 1 1000000000
    help
        The default maximum data frame write size for a XSP WS client loop. Larger messages will be
        fragmented into frames of at most this size.

config XSP_WS_CLIENT_LOOP_DEFAULT_POLL_READ_TIMEOUT_MS
    int "Default poll read timeout in milliseconds (default 0)"
    default 0
    range 0 1000000000
    help
        The default poll read timeout for a XSP WS client loop.

config XSP_WS_CLIENT_LOOP_DEFAULT_POLL_WRITE_TIMEOUT_MS
    int "Default poll write timeout in milliseconds (default 0)"
    default 0
    range 0 1000000000
    help
        The default poll write timeout for a XSP WS client loop.

config XSP_WS_CLIENT_LOOP_DEFAULT_READ_TIMEOUT_MS
    int "Default read timeout in milliseconds (default 3000)"
    default 3000
    range 0 1000000000
    help
        The default read timeout for a XSP WS client loop.

config XSP_WS_CLIENT_LOOP_DEFAULT_WRITE_TIMEOUT_MS
    int "Default write timeout in milliseconds (default 3000)"
    default 3000
    range 0 1000000000
    help
        The default write timeout for a XSP WS client loop.

endmenu
```

## examples/button_event/main/Kconfig.projbuild
```kconfig
# Copyright 2019 Tricot Inc.
# Use of this source code is governed by the license in the LICENSE file.

menu "Button event example configuration"

config BUTTON_GPIO_NUM
    int "Button GPIO number (default: 0)"
    default 0
    range 0 39
    help
        The GPIO number of the button (0-39, except 20, 24, 28-31).

config BUTTON_ACTIVE
    int "Button GPIO active low or high (default: 0=low)."
    default 0
    range 0 1
    help
        Whether the GPIO is low (0) or high (1) when the button is active/depressed.
        (Pull-up/pull-down and edge interrupt will be configured accordingly.)

config BUTTON_EVENT_ON_ACTIVE
    int "Generate an event when the button is pressed (default: 0=released)."
    default 0
    range 0 1
    help
        Whether the event is generated when the GPIO becomes active (i.e., the button is depressed).
        (Interrupt edge will be configured accordingly.)

endmenu
```

## examples/ws_client/main/Kconfig.projbuild
```kconfig
# Copyright 2019 Tricot Inc.
# Use of this source code is governed by the license in the LICENSE file.

menu "WS (WebSocket) client example configuration"

config WIFI_SSID
    string "WiFi SSID"
	default "myssid"
	help
		SSID (network name) of the WiFi network to connect to.

config WIFI_PASSWORD
    string "WiFi Password"
	default "mypassword"
	help
		WiFi password (WPA or WPA2) for the WiFi network to connect to. Leave blank for no security.

config MAIN_URL
    string "WebSocket URL to connect to"
    default "ws://echo.websocket.org"
    help
        WebSocket (ws or wss) URL to connect to. Suggested values: "ws://echo.websocket.org",
        "wss://echo.websocket.org", "ws://broker.hivemq.com:8000/mqtt", "ws://my_address:8080/echo".

config MAIN_SUBPROTOCOLS
    string "Application subprotocols (blank for none)"
    default ""
    help
        WebSocket application-level subprotocols to request; comma-separated string (with optional
        spaces), or blank for none. Suggested values: "", "echo", "mqtt".

config MAIN_NUM_SENDS
    int "Number of messages to send (default: 10)"
    default 10
    range 0 1000000000
    help
        Number of messages to send.

config MAIN_NUM_DONE_IDLES
    int "Number of idle periods after sends (default: 100)"
    default 100
    range 0 1000000000
    help
        Number of idle periods to remain connected after sending messages.

config MAIN_DONE_IDLE_PING_INTERVAL
    int "Idle ping interval in idle periods (default: 30)"
    default 30
    range 1 1000000000
    help
        Number of idle periods between which pings will be sent, after sending messages.

config MAIN_IDLE_SLEEP_MS
    int "Idle sleep time in milliseconds (default: 10)"
    default 10
    range 0 1000
    help
        Idle sleep time in milliseconds. You shouldn't need to change this, typically.

config MAIN_TRUNC_SIZE
    int "Message logging truncation size (default: 40)"
    default 40
    range 0 200
    help
        The number of characters from messages to log.

endmenu
```

## examples/ws_client2/main/Kconfig.projbuild
```kconfig
# Copyright 2019 Tricot Inc.
# Use of this source code is governed by the license in the LICENSE file.

menu "WS (WebSocket) client example configuration"

config WIFI_SSID
    string "WiFi SSID"
	default "myssid"
	help
		SSID (network name) of the WiFi network to connect to.

config WIFI_PASSWORD
    string "WiFi Password"
	default "mypassword"
	help
		WiFi password (WPA or WPA2) for the WiFi network to connect to. Leave blank for no security.

config MAIN_URL
    string "WebSocket URL to connect to"
    default "ws://echo.websocket.org"
    help
        WebSocket (ws or wss) URL to connect to. Suggested values: "ws://echo.websocket.org",
        "wss://echo.websocket.org", "ws://broker.hivemq.com:8000/mqtt", "ws://my_address:8080/echo".

config MAIN_SUBPROTOCOLS
    string "Application subprotocols (blank for none)"
    default ""
    help
        WebSocket application-level subprotocols to request; comma-separated string (with optional
        spaces), or blank for none. Suggested values: "", "echo", "mqtt".

config MAIN_NUM_SENDS
    int "Number of messages to send (default: 10)"
    default 10
    range 0 1000000000
    help
        Number of messages to send.

config MAIN_NUM_DONE_IDLES
    int "Number of idle periods after sends (default: 6000)"
    default 6000
    range 0 1000000000
    help
        Number of idle periods to remain connected after sending messages.

config MAIN_DONE_IDLE_PING_INTERVAL
    int "Idle ping interval in idle periods (default: 300)"
    default 300
    range 1 1000000000
    help
        Number of idle periods between which pings will be sent, after sending messages.

config MAIN_TRUNC_SIZE
    int "Message payload logging size (default: 40)"
    default 40
    range 0 200
    help
        The number of characters from message payloads to log.

endmenu
```

## examples/ws_client_test2/main/Kconfig.projbuild
```kconfig
# Copyright 2019 Tricot Inc.
# Use of this source code is governed by the license in the LICENSE file.

menu "WS (WebSocket) client test configuration"

config WIFI_SSID
    string "WiFi SSID"
	default "myssid"
	help
		SSID (network name) of the WiFi network to connect to.

config WIFI_PASSWORD
    string "WiFi Password"
	default "mypassword"
	help
		WiFi password (WPA or WPA2) for the WiFi network to connect to. Leave blank for no security.

config MAIN_AUTOBAHN_SERVER_BASE_URL
    string "Autobahn fuzzingserver base URL"
    default "ws://my_address:9001"
    help
        Base (WebSocket) URL for the Autobahn WebSocket Fuzzing Server (fuzzingserver), not
        including any path (or even any trailing slash). It is usually ws://<server address>:9001.

config MAIN_IDLE_SLEEP_MS
    int "Idle sleep time in milliseconds (default: 10)"
    default 10
    range 0 1000
    help
        Idle sleep time in milliseconds. You shouldn't need to change this, typically.

endmenu
```
